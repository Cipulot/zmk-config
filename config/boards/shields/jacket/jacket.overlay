 #include <dt-bindings/zmk/matrix_transform.h>

 / {
     chosen {
         zmk,kscan = &default_kscan;
     };

     default_kscan: kscan {
         compatible = "zmk,kscan-gpio-matrix";
         label = "default_kscan";
         diode-direction = "col2row";

         col-gpios
         = <&gpio0 31 GPIO_ACTIVE_HIGH>
         , <&gpio0 29 GPIO_ACTIVE_HIGH>
         , <&gpio0 2 GPIO_ACTIVE_HIGH>
         , <&gpio1 15 GPIO_ACTIVE_HIGH>
         , <&gpio1 13 GPIO_ACTIVE_HIGH>
         , <&gpio1 11 GPIO_ACTIVE_HIGH>
         , <&gpio0 10 GPIO_ACTIVE_HIGH>
         , <&gpio0 9 GPIO_ACTIVE_HIGH>
         , <&gpio0 6 GPIO_ACTIVE_HIGH>
         , <&gpio0 8 GPIO_ACTIVE_HIGH>
         , <&gpio0 17 GPIO_ACTIVE_HIGH>
         , <&gpio0 20 GPIO_ACTIVE_HIGH>
         , <&gpio0 22 GPIO_ACTIVE_HIGH>
         , <&gpio0 24 GPIO_ACTIVE_HIGH>
         , <&gpio1 0 GPIO_ACTIVE_HIGH>
         , <&gpio0 11 GPIO_ACTIVE_HIGH>
         , <&gpio1 4 GPIO_ACTIVE_HIGH>
         , <&gpio1 6 GPIO_ACTIVE_HIGH>
         ;

         row-gpios
         = <&gpio1 1 (GPIO_ACTIVE_HIGH | GPIO_PULL DOWN)>
         , <&gpio1 2 (GPIO_ACTIVE_HIGH | GPIO_PULL DOWN)>
         , <&gpio1 3 (GPIO_ACTIVE_HIGH | GPIO_PULL DOWN)>
         ;
     };
 };