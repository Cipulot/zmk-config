## config/app/boards/arm/mrwhosetheboss/Kconfig.board
```kconfig
# mrwhosethebossboard configuration

# Copyright (c) 2020 The ZMK Contributors
# SPDX-License-Identifier: MIT

config BOARD_mrwhosetheboss
	bool "mrwhosetheboss Keyboard"
	depends on SOC_NRF52840_QIAA
```

## config/boards/shields/jacket/Kconfig.defconfig
```kconfig
if SHIELD_JACKET

config ZMK_KEYBOARD_NAME
    default "Jacket"

config ZMK_BLE
	default y

endif
```

## config/boards/shields/mrwhosetheboss/Kconfig.defconfig
```kconfig
if SHIELD_mrwhosetheboss

config ZMK_KEYBOARD_NAME
    default "mrwhosetheboss"

endif
```

## config/boards/shields/mrwhosetheboss/Kconfig.shield
```kconfig
config SHIELD_mrwhosetheboss
    def_bool $(shields_list_contains,mrwhosetheboss)
```
